## Documentation/devicetree/bindings/power/reset/da9063-reset.yaml
```yaml
# SPDX-License-Identifier: (GPL-2.0-only OR BSD-2-Clause)
%YAML 1.2
---
$id: http://devicetree.org/schemas/power/reset/da9063-reset.yaml#
$schema: http://devicetree.org/meta-schemas/core.yaml#

title: Reset driver for Dialog DA9063/DA9063L Power Management Integrated Circuit (PMIC)

maintainers:
  - Support Opensource <support.opensource@diasemi.com>

description: |
  This module is part of the DA9063 MFD device. For more details, see
  Documentation/devicetree/bindings/mfd/da9063.yaml.

  The regulator controller is represented as a sub-node of the PMIC node
  on the device tree.

  This node defines the reset settings controlled by the device. The
  node should contain the compatible property with the value "dlg,da9063-reset".

properties:
  compatible:
    const: dlg,da9063-reset

  priority:
    description: |
      A priority ranging from 0 to 255 (default 128) according to
      the following guidelines:
          0:   Restart handler of last resort, with limited restart
               capabilities
        128:   Default restart handler; use if no other restart handler is
               expected to be available, and/or if restart functionality is
               sufficient to restart the entire system
        255:   Highest priority restart handler, will preempt all other
               restart handlers
    maxItems: 1

required:
  - compatible

additionalProperties: false
```
